## conf/distro/poky-haly.conf
```bitbake
require conf/distro/poky.conf

DISTRO = "poky-haly"

DISTRO_FEATURES_remove ?= "opengl wayland x11 3g nfc pulseaudio cramgs directgb irda pci pcmcia wifi"

DISTRO_FEATURES ?= "btrfs"

# icu is needed to get qtwebkit
PACKAGECONFIG_DISTRO_pn-qtbase ?= "icu tslib openssl"

# Because there is no opengl, some qt packages are empty
ALLOW_EMPTY_qt3d-mkspecs = "1"
ALLOW_EMPTY_qt3d-qmlplugins = "1"
ALLOW_EMPTY_qtconnectivity-qmlplugins = "1"
ALLOW_EMPTY_qtgraphicaleffects-qmlplugins = "1"
ALLOW_EMPTY_qtlocation-qmlplugins = "1"
ALLOW_EMPTY_qtmultimedia-qmlplugins = "1"
ALLOW_EMPTY_qtsensors-qmlplugins = "1"
ALLOW_EMPTY_qtsystems-qmlplugins = "1"
ALLOW_EMPTY_qttools-plugins = "1"
ALLOW_EMPTY_qtwebchannel-qmlplugins = "1"
ALLOW_EMPTY_qtwebkit-qmlplugins = "1"
ALLOW_EMPTY_qtwebsockets-qmlplugins = "1"

EXTRA_OECONF_remove = "${DISABLE_STATIC}"

#PREFERRED_PROVIDER_virtual/kernel ?= "linux-at91"
PREFERRED_VERSION_linux-at91 ?= "4.9%"
```
